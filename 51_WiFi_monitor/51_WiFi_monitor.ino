#include <WiFi.h>
#include <ESPping.h>
#include <Adafruit_GFX.h>
#include <Adafruit_NeoMatrix.h>
#include <Adafruit_NeoPixel.h>

const char* WIFI_SSID = "WiFi Name";  // Your SSID
const char* WIFI_PWD = "Password";    // Your WiFi Password

// Which pin on the Arduino is connected to the NeoPixels?
#define PIN 4

// Max is 255, 32 is a conservative value to not overload
// a USB power supply (500mA) for 12x12 pixels.
#define MAXBRIGHTNESS 32

// Define matrix width and height.
#define mw 8
#define mh 8

#define WIFI_DISCONNECTED 5
#define NO_INTERNET 6

bool fading = true;
bool pingSuccess = false;
uint8_t brightness = MAXBRIGHTNESS;

unsigned long pingMillis;
unsigned long fadeMillis;
const unsigned long pingDelay = 2000;
const unsigned long fadeDelay = 200;

// When we setup the NeoPixel library, we tell it how many pixels, and which pin to use to send signals.
// Note that for older NeoPixel strips you might need to change the third parameter--see the strandtest
// example for more information on possible values.
Adafruit_NeoMatrix* matrix = new Adafruit_NeoMatrix(mw, mh, PIN,
                                                    NEO_MATRIX_TOP + NEO_MATRIX_LEFT + NEO_MATRIX_ROWS + NEO_MATRIX_ZIGZAG,
                                                    NEO_GRB + NEO_KHZ800);

static const uint16_t PROGMEM RGB_bmp[][64] = {
  //0 bar
  {
  0x000,	0x000,	0x000,	0x000,	0x000,	0x000,	0x000,	0x000,
  0x000,	0x000,	0x000,	0x000,	0x000,	0x000,	0x000,	0x000,
  0x000,	0x000,	0x000,	0x000,	0x000,	0x000,	0x000,	0x000,
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  0x000,	0x000,	0x000,	0xF93,	0xF93,	0x000,	0x000,	0x000,
  },
  //1 bar
  {
  0x000,	0x000,	0x000,	0x000,	0x000,	0x000,	0x000,	0x000,
  0x000,	0x000,	0x000,	0x000,	0x000,	0x000,	0x000,	0x000,
  0x000,	0x000,	0x000,	0x000,	0x000,	0x000,	0x000,	0x000,
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  0x000,	0x000,	0x000,	0xF93,	0xF93,	0x000,	0x000,	0x000,
  },
  //2 bars
  {
  0x000,	0x000,	0x000,	0x000,	0x000,	0x000,	0x000,	0x000,
  0x000,	0x000,	0x000,	0x000,	0x000,	0x000,	0x000,	0x000,
  0x000,	0x000,	0x000,	0x000,	0x000,	0x000,	0x000,	0x000,
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  0x000,	0x000,	0x000,	0xF93,	0xF93,	0x000,	0x000,	0x000,
  },
  //3 bars
  {
  0x000,	0x000,	0x000,	0x000,	0x000,	0x000,	0x000,	0x000,
  0x000,	0x000,	0x000,	0x000,	0x000,	0x000,	0x000,	0x000,
  0x000,	0xF93,	0xF93,	0xF93,	0xF93,	0xF93,	0xF93,	0x000,
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  0x000,	0x000,	0x000,	0xF93,	0xF93,	0x000,	0x000,	0x000,
  },
  //4 bars
  {
  0x000,	0xF93,	0xF93,	0xF93,	0xF93,	0xF93,	0xF93,	0x000,
  0xF93,	0x000,	0x000,	0x000,	0x000,	0x000,	0x000,	0xF93,
  0x000,	0xF93,	0xF93,	0xF93,	0xF93,	0xF93,	0xF93,	0x000,
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  0x000,	0x000,	0x000,	0xF93,	0xF93,	0x000,	0x000,	0x000,
  },
  //WIFI disconnected
  {
  0x000,	0x00F,	0x00F,	0x00F,	0x00F,	0x00F,	0x00F,	0x000,
  0x00F,	0x000,	0x000,	0x000,	0x000,	0x000,	0x000,	0x00F,
  0x000,	0x00F,	0x00F,	0x00F,	0x00F,	0x00F,	0x00F,	0x000,
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  0x000,	0x000,	0x000,	0x00F,	0x00F,	0x000,	0x000,	0x000,
  },
  //No internet
  {
  0x000,	0xF93,	0xF93,	0xF93,	0xF93,	0xF93,	0xF93,	0x00F,
  0xF93,	0x00F,	0x000,	0x000,	0x000,	0x000,	0x000,	0xF93,
  0x000,	0xF93,	0xF93,	0xF93,	0xF93,	0x00F,	0xF93,	0x000,
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  0x000,	0x000,	0x000,	0xF93,	0xF93,	0x000,	0x000,	0x000,
  },
};


void display_rgbBitmap(uint8_t bmp_num) {
  static uint16_t bmx, bmy;

  fixdrawRGBBitmap(bmx, bmy, RGB_bmp[bmp_num], 8, 8);
  bmx += 8;
  if (bmx >= mw) bmx = 0;
  if (!bmx) bmy += 8;
  if (bmy >= mh) bmy = 0;
  matrix->show();
}

// Convert a BGR 4/4/4 bitmap to RGB 5/6/5 used by Adafruit_GFX
void fixdrawRGBBitmap(int16_t x, int16_t y, const uint16_t* bitmap, int16_t w, int16_t h) {
  uint16_t RGB_bmp_fixed[w * h];
  for (uint16_t pixel = 0; pixel < w * h; pixel++) {
    uint8_t r, g, b;
    uint16_t color = pgm_read_word(bitmap + pixel);

    //Serial.print(color, HEX);
    b = (color & 0xF00) >> 8;
    g = (color & 0x0F0) >> 4;
    r = color & 0x00F;
    b = map(b, 0, 15, 0, 31);
    g = map(g, 0, 15, 0, 63);
    r = map(r, 0, 15, 0, 31);
    RGB_bmp_fixed[pixel] = (r << 11) + (g << 5) + b;
  }
  matrix->drawRGBBitmap(x, y, RGB_bmp_fixed, w, h);
}

void setup() {
  // put your setup code here, to run once:
  Serial.begin(115200);
  matrix->begin();
  matrix->setBrightness(brightness);
  matrix->clear();
  connect_wifi();
}

void loop() {
  if (pingSuccess & (millis() - fadeMillis >= fadeDelay)) {
    fadeMatrix();
    fadeMillis = millis();
  } else
    matrix->setBrightness(MAXBRIGHTNESS);

  if (WiFi.status() == WL_CONNECTED) {
    if (millis() - pingMillis >= pingDelay)  //test whether the period has elapsed
    {
      if (pingTest())
        display_rgbBitmap(4);
      else
        display_rgbBitmap(NO_INTERNET);
      pingMillis = millis();
    }
  } else {
    display_rgbBitmap(WIFI_DISCONNECTED);
    connect_wifi();
  }
}

void connect_wifi() {
  WiFi.mode(WIFI_STA);  //Optional
  WiFi.begin(WIFI_SSID, WIFI_PWD);
  Serial.println("\nConnecting");

  uint8_t bmp_num = 1;
  while (WiFi.status() != WL_CONNECTED) {
    Serial.print(".");
    delay(500);
    display_rgbBitmap(bmp_num++);
    if (bmp_num > 4) bmp_num = 1;
  }

  Serial.println("\nConnected to the WiFi network");
  Serial.print("Local ESP32 IP: ");
  Serial.println(WiFi.localIP());
}

bool pingTest() {
  IPAddress ip(8, 8, 8, 8);  // The remote ip to ping
  Serial.print("Pinging host : ");
  Serial.println(ip);
  if (Ping.ping(ip, 2)) {  // Ping the remote host with two ping requests
    Serial.println("Ping success");
    pingSuccess = true;
  } else {
    Serial.println("Ping Error");
    pingSuccess = false;
  };
  return pingSuccess;
};

void fadeMatrix() {
  if (fading) {
    brightness--;
    if (brightness < 10) {
      brightness = 10;
      fading = !fading;
    }
    matrix->setBrightness(brightness);
    matrix->show();
  } else {
    brightness++;
    if (brightness > MAXBRIGHTNESS) {
      brightness = MAXBRIGHTNESS;
      fading = !fading;
    }
    matrix->setBrightness(brightness);
    matrix->show();
  }
}